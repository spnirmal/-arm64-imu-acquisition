## buildroot-external/Config.in
```kconfig
menu "Custom packages"

source "$BR2_EXTERNAL_DRIVERLAB_PATH/package/spi-userspace-acquisition/Config.in"
source "$BR2_EXTERNAL_DRIVERLAB_PATH/package/iio-userspace-acquisition/Config.in"
source "$BR2_EXTERNAL_DRIVERLAB_PATH/package/imu-zerocopy/Config.in"
source "$BR2_EXTERNAL_DRIVERLAB_PATH/package/zerocopy-userspace-acquisition/Config.in"

endmenu
```

## buildroot-external/package/iio-userspace-acquisition/Config.in
```kconfig
config BR2_PACKAGE_IIO_USERSPACE_ACQUISITION
	bool "iio-userspace-acquisition"
	depends on BR2_INSTALL_LIBSTDCPP
	help
	  IIO sensor data acquisition and benchmarking application for Arch-B.

comment "iio-userspace-acquisition needs a toolchain w/ C++"
	depends on !BR2_INSTALL_LIBSTDCPP
```

## buildroot-external/package/imu-zerocopy/Config.in
```kconfig
config BR2_PACKAGE_IMU_ZEROCOPY
	bool "imu-zerocopy"
	depends on BR2_LINUX_KERNEL
	help
	  High-performance zero-copy SPI driver for Invensense MPU6500/9250 IMU.
	  Provides /dev/imu_zerocopy misc character device with an SPSC
	  ring buffer directly mapped to userspace via mmap().

comment "imu-zerocopy needs a Linux kernel to be built"
	depends on !BR2_LINUX_KERNEL
```

## buildroot-external/package/spi-userspace-acquisition/Config.in
```kconfig
config BR2_PACKAGE_SPI_USERSPACE_ACQUISITION
	bool "spi-userspace-acquisition"
	depends on BR2_INSTALL_LIBSTDCPP
	depends on BR2_TOOLCHAIN_HEADERS_AT_LEAST_4_8 # libgpiod
	select BR2_PACKAGE_LIBGPIOD
	help
	  SPI userspace acquisition test application.

comment "spi-userspace-acquisition needs a toolchain w/ C++, headers >= 4.8"
	depends on !BR2_INSTALL_LIBSTDCPP || !BR2_TOOLCHAIN_HEADERS_AT_LEAST_4_8
```

## buildroot-external/package/zerocopy-userspace-acquisition/Config.in
```kconfig
config BR2_PACKAGE_ZEROCOPY_USERSPACE_ACQUISITION
	bool "zerocopy-userspace-acquisition"
	depends on BR2_INSTALL_LIBSTDCPP
	depends on BR2_PACKAGE_IMU_ZEROCOPY
	help
	  Zero-copy IMU sensor consumer and benchmarking application for Arch-C.
	  Directly mmaps /dev/imu_zerocopy SPSC ring buffer into userspace.

comment "zerocopy-userspace-acquisition needs a toolchain w/ C++"
	depends on !BR2_INSTALL_LIBSTDCPP
```
